<div class="sidebar-section">
  <a href="index.shtml">About</a><br />
  <a href="downloads.shtml">Downloads</a><br />
  <a href="faq.shtml">FAQ</a><br />
  <a href="screenshots.shtml">Screenshots</a><br />
  <a href="love.shtml">Love</a><br />
  <a href="contact.shtml">Contact</a><br />
</div>
<div class="sidebar-section">
  <a href="building.shtml">Building from SVN</a><br />
  <a href="http://cia.navi.cx/stats/project/navi-misc/xchat-gnome">CIA Stats</a><br />
  <a href="http://navi.cx/svn/misc/trunk/xchat-gnome">Subversion</a><br />
</div>
<div class="sidebar-section">
  <a href="http://bugzilla.gnome.org/enter_bug.cgi?product=xchat-gnome">New Bug</a><br />
  <a href="http://bugzilla.gnome.org/enter_bug.cgi?product=xchat-gnome&amp;bug_severity=enhancement">New Patch</a><br />
  <a href="http://bugzilla.gnome.org/buglist.cgi?product=xchat-gnome&amp;bug_status=UNCONFIRMED&amp;bug_status=NEW&amp;bug_status=ASSIGNED&amp;bug_status=REOPENED">Bugzilla</a><br />
</div>
